## CMakeLists.txt
```
# Copyright (c) 2025 The FINCH CubeSat Project Flight Software Contributors
# SPDX-License-Identifier: Apache-2.0

cmake_minimum_required(VERSION 3.20.0)
find_package(Zephyr REQUIRED HINTS $ENV{ZEPHYR_BASE})
project(obc)

target_sources(app PRIVATE main.c)
```

## prj.conf
```kconfig
# SPDX-License-Identifier: Apache-2.0

CONFIG_LOG=y
CONFIG_LOG_DEFAULT_LEVEL=3
CONFIG_COMPILER_WARNINGS_AS_ERRORS=y

CONFIG_RTC=y

CONFIG_I2C=y
CONFIG_GPIO=y
CONFIG_GPIO_STM32=y
CONFIG_COUNTER=y                     
CONFIG_COUNTER_MICROCHIP_MCP7940N=y

# Enable logging
CONFIG_LOG=y
CONFIG_LOG_MODE_DEFERRED=y  # or y/n depending on your needs

# Enable log backend
CONFIG_LOG_BACKEND_UART=y

CONFIG_LOG_BACKEND_UART=y
CONFIG_I2C=y
CONFIG_GPIO=y
CONFIG_GPIO_STM32=y
CONFIG_COUNTER=y
CONFIG_SERIAL=y
CONFIG_CONSOLE=y
CONFIG_PRINTK=y
```

## src/main.c
```c
/*
 * Copyright (c) 2024, Muhammad Waleed Badar
 *
 * SPDX-License-Identifier: Apache-2.0
 */

#include <zephyr/kernel.h>
#include <zephyr/device.h>
#include <zephyr/drivers/rtc.h>
#include <zephyr/drivers/uart.h>
#include <zephyr/sys/util.h>

const struct device *rtc = DEVICE_DT_GET(DT_NODELABEL(mcp7940n));
const struct device *uart = DEVICE_DT_GET(DT_NODELABEL(usart1));

void print(const char* str)
{
	for (int i = 0; i < strlen(str); ++i) {
		uart_poll_out(uart, str[i]);
	}
}

static int set_date_time(const struct device *rtc)
{
	int ret = 0;
	struct rtc_time tm = {
		.tm_year = 2024 - 1900,
		.tm_mon = 11 - 1,
		.tm_mday = 17,
		.tm_hour = 4,
		.tm_min = 19,
		.tm_sec = 0,
	};

	ret = rtc_set_time(rtc, &tm);
	if (ret < 0) {
		return ret;
	}
	return ret;
}

int main(void)
{
	print("hello, zephyr!\r\n");
		
	/* Check if the RTC is ready */
	if (!device_is_ready(rtc)) {
		print("rip\r\n");
		return 0;
	}

	set_date_time(rtc);

	/* Continuously read the current date and time from the RTC */
	while (1) {
		struct rtc_time tm;
		rtc_get_time(rtc, &tm);

		char buf[64];
		snprintf(buf, sizeof(buf), "time: %d\r\n", tm.tm_sec);
		for (int i = 0; i < strlen(buf); ++i) {
			uart_poll_out(uart, buf[i]);
		}

		k_msleep(1000);
	};
	return 0;
}
```
