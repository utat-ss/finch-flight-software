## boards/pay/board.yml
```yaml
board:
  name: pay
  full_name: FINCH_PAY
  vendor: The FINCH CubeSat Project Contributors
  socs:
    - name: stm32h743xx
```

## lib/adcs/Kconfig
```kconfig
# Copyright (c) 2025 The FINCH CubeSat Project Flight Software Contributors
# SPDX-License-Identifier: Apache-2.0

config FINCH_ADCS
	bool "Support for ADCS"
	help
	  Enables the ADCS library
```

## lib/ccsds123b/Kconfig
```kconfig
# Copyright (c) 2025 The FINCH CubeSat Project Flight Software Contributors
# SPDX-License-Identifier: Apache-2.0

config FINCH_CCSDS123B
	bool "Support for CCSDS123B"
	help
	  This option enables the CCSDS123B compression library
```

## lib/csputils/Kconfig
```kconfig
# Copyright (c) 2025 The FINCH CubeSat Project Flight Software Contributors
# SPDX-License-Identifier: Apache-2.0

config FINCH_CSPUTILS
	bool "Support for CSP Utils"
	help
	  This option enables CSP utility functions
```

## lib/libcsp_test/Kconfig
```kconfig
# Copyright (c) 2025 The FINCH CubeSat Project Flight Software Contributors
# SPDX-License-Identifier: Apache-2.0

config FINCH_LIBCSPTEST
	bool "Testing LIBCSP"
	help
	  This option enables the libcsp test
```
