/ {
	chosen {
		zephyr,canbus = &fdcan1;
	};
};

&fdcan1 {
	pinctrl-0 = <&fdcan1_rx_pa11 &fdcan1_tx_pa12>;
	pinctrl-names = "default";
	bitrate = <100000>;
	sample-point = <875>;
	clocks = <&rcc STM32_CLOCK_BUS_APB1 0x02000000>,
		 <&rcc STM32_SRC_PLL_Q FDCAN_SEL(1)>;
	status = "okay";
};
