## CMakeLists.txt
```
cmake_minimum_required(VERSION 3.20.0)
find_package(Zephyr REQUIRED HINTS $ENV{ZEPHYR_BASE})
project(benchmark-ccsds123b)

include_directories(../../include)

file(GLOB SOURCES src/*.c)

set(CCSDS123B_SOURCES
    ${CMAKE_CURRENT_SOURCE_DIR}/../../lib/ccsds123b/src/constants.c
    ${CMAKE_CURRENT_SOURCE_DIR}/../../lib/ccsds123b/src/encoder.c
    ${CMAKE_CURRENT_SOURCE_DIR}/../../lib/ccsds123b/src/predictor.c
    ${CMAKE_CURRENT_SOURCE_DIR}/../../lib/ccsds123b/src/util.c
)

target_sources(app PRIVATE ${SOURCES} ${CCSDS123B_SOURCES})
```

## prj.conf
```kconfig
CONFIG_TIMING_FUNCTIONS=y
CONFIG_LOG=y
CONFIG_LOG_DEFAULT_LEVEL=3
CONFIG_NEWLIB_LIBC=y
CONFIG_PICOLIBC=n
```

## src/main.c
```c
#include <finch/ccsds123b/predictor.h>
#include <finch/ccsds123b/encoder.h>
#include <finch/ccsds123b/image.h>
#include <finch/ccsds123b/util.h>

#include <stdio.h>
#include <zephyr/kernel.h>
#include <zephyr/timing/timing.h>
#include <zephyr/logging/log.h>
#include <zephyr/logging/log_ctrl.h>

#include "benchmark.h"

int prediction[N_TILE_Z][N_TILE_Y][N_TILE_X];

LOG_MODULE_REGISTER(bench);

timing_t start_time;

void measure_start() {
	timing_init();
	timing_start();
	start_time = timing_counter_get();
}

uint64_t timing_measure_ms() {
	timing_t end_time = timing_counter_get();
	uint64_t total_cycles = timing_cycles_get(&start_time, &end_time);
	uint64_t total_ns = timing_cycles_to_ns(total_cycles);
	return total_ns / 1000000;
}

int main(void)
{
	measure_start();

	img_init();
	const vec3 *N = img_get_N();

	LOG_INF("Image initialized -- %llu ms", timing_measure_ms());

	LOG_INF("Calling predict_image");

	predict_image(N, prediction);

	LOG_INF("Finished predict_image -- %llu ms since start", timing_measure_ms());
	log_flush();

	timing_stop();

	/*char encoding[N->z][N->y][N->x][32];

	encode_prediction(N, prediction, encoding);

	printk("-----------------------------------\nEncoding\n\n");
	for (int z = 0; z < N->z; ++z) {
		for (int y = 0; y < N->y; ++y) {
			for (int x = 0; x < N->x; ++x)
				printk("%s ", encoding[z][y][x]);
			printk("\n");
		}
		printk("\n");
	}

	int prediction_new[N->z][N->y][N->x];

	decode_encoding(N, encoding, prediction_new);

	printk("-----------------------------------\nDecoding\n\n");
	for (int z = 0; z < N->z; ++z) {
		for (int y = 0; y < N->y; ++y) {
			for (int x = 0; x < N->x; ++x)
				printk("%d ", prediction_new[z][y][x]);
			printk("\n");
		}
		printk("\n");
	}

	int image_new[N->z][N->y][N->x];

	reconstruct_prediction(N, prediction_new, image_new);

	printk("-----------------------------------\nReconstruction\n\n");
	for (int z = 0; z < N->z; ++z) {
		for (int y = 0; y < N->y; ++y) {
			for (int x = 0; x < N->x; ++x)
				printk("%d ", image_new[z][y][x]);
			printk("\n");
		}
		printk("\n");
	}*/
}
```

## src/arrays.c
```c
#include <finch/ccsds123b/arrays.h>
#include "benchmark.h"

void update_local_diffs(LocalDiffs local_diffs, int z, int y, int x, const LocalDiff* l) {
    local_diffs[z % N_TILE_Z][y % N_TILE_Y][x % N_TILE_X] = *l;
}

LocalDiff get_local_diffs(const LocalDiffs local_diffs, int z, int y, int x) {
    return local_diffs[z % N_TILE_Z][y % N_TILE_Y][x % N_TILE_X];
}

void update_predictions(Predictions predictions, int z, int y, int x, int32_t p) {
    predictions[z % N_TILE_Z][y % N_TILE_Y][x % N_TILE_X] = p;
}

int32_t get_predictions(const Predictions predictions, int z, int y, int x) {
    return predictions[z % N_TILE_Z][y % N_TILE_Y][x % N_TILE_X];
}
```

## src/benchmark.h
```c
#ifndef BENCHMARK_H
#define BENCHMARK_H

#define N_TILE_Z 10
#define N_TILE_Y 10
#define N_TILE_X 5

#define N_Z 50
#define N_Y 50
#define N_X 50

#endif
```

## src/image.c
```c
#include <finch/ccsds123b/image.h>

#include "benchmark.h"
#include "finch/ccsds123b/util.h"
/*
	Test implementation of image.c, repeatedly sampling a smaller image instead of storing all of it in memory.
*/

vec3 N_tile = (vec3){ N_TILE_Z, N_TILE_Y, N_TILE_X };
int img[N_TILE_Z][N_TILE_Y][N_TILE_X];

vec3 N = (vec3) { N_Z, N_Y, N_X };

void img_init(void)
{
	int c = 0;

	for (int z = 0; z < N_tile.z; ++z) {
		for (int y = 0; y < N_tile.y; ++y) {
			for (int x = 0; x < N_tile.x; ++x) {
				img[z][y][x] = c++;
			}
		}
	}
}

const vec3 *img_get_N(void)
{
	return &N;
}

int img_get_pxl(int z, int y, int x)
{
	return img[z % N_tile.z][y % N_tile.y][x % N_tile.x];
}

int img_get_pxl_t(int z, int t)
{
	int y = t / N.x;
	int x = t % N.x;

	return img_get_pxl(z, y, x);
}
```

## src/local_diffs.c
```c
#include <finch/ccsds123b/local_diffs.h>
#include "benchmark.h"

LocalDiffs local_diffs;

void update_local_diffs(int z, int y, int x, const LocalDiff* l) {
    local_diffs[z % N_TILE_Z][y % N_TILE_Y][x % N_TILE_X] = *l;
}

LocalDiff get_local_diffs(int z, int y, int x) {
    return local_diffs[z % N_TILE_Z][y % N_TILE_Y][x % N_TILE_X];
}
```
