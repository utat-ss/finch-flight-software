## CMakeLists.txt
```
cmake_minimum_required(VERSION 3.20)
find_package(Zephyr REQUIRED HINTS $ENV{ZEPHYR_BASE})
project(blinky1)
target_sources(app PRIVATE src/main.c)
```

## prj.conf
```kconfig
# Enable STREAM_FLASH first (required dependency for IMG_MANAGER)
CONFIG_STREAM_FLASH=y

# Enable IMG_MANAGER (parent config)
CONFIG_IMG_MANAGER=y

# Then enable MCUboot variant (this is selected automatically as default, but be explicit)
CONFIG_MCUBOOT_IMG_MANAGER=y

# Required dependencies
CONFIG_BOOTLOADER_MCUBOOT=y
CONFIG_FLASH=y
CONFIG_FLASH_MAP=y

# Reboot support
CONFIG_REBOOT=y

# Allowing insisgned
CONFIG_MCUBOOT_GENERATE_UNSIGNED_IMAGE=y

# Logging (optional)
CONFIG_LOG=y
CONFIG_PRINTK=y
CONFIG_CONSOLE=y
CONFIG_UART_CONSOLE=y
```

## src/main.c
```c
#include <stdio.h>
#include <zephyr/kernel.h>
#include <zephyr/drivers/gpio.h>
#include <zephyr/dfu/mcuboot.h>   // gives us boot_request_upgrade()
#include <zephyr/sys/reboot.h>    // gives us sys_reboot()

/* 1000 msec = 1 sec */
#define SLEEP_TIME_MS   100

/* The devicetree node identifier for the "led0" alias. */
#define LED0_NODE DT_ALIAS(led0)
#define SW0_NODE DT_ALIAS(sw0)

/*
 * A build error on this line means your board is unsupported.
 * See the sample documentation for information on how to fix this.
 */
static const struct gpio_dt_spec led = GPIO_DT_SPEC_GET(LED0_NODE, gpios);
static const struct gpio_dt_spec button = GPIO_DT_SPEC_GET(SW0_NODE, gpios);

int main(void)
{
	int ret;
	bool led_state = true;

	if (!gpio_is_ready_dt(&led)) {
		return 0;
	}
    if (!gpio_is_ready_dt(&button)) {
        return 0;
    }

	ret = gpio_pin_configure_dt(&led, GPIO_OUTPUT_ACTIVE);
	if (ret < 0) {
		return 0;
	}
    ret = gpio_pin_configure_dt(&button, GPIO_INPUT);
    if (ret < 0) {
        return 0;
    }

	while (1) {
		ret = gpio_pin_toggle_dt(&led);
		if (ret < 0) {
			return 0;
		}

		led_state = !led_state;
		printf("LED state: %s\n", led_state ? "ON" : "OFF");
		
        if (gpio_pin_get_dt(&button) == 1) {
            printf("Button pressed, switching firmware...\n");
            boot_request_upgrade(BOOT_UPGRADE_TEST);
            sys_reboot(SYS_REBOOT_COLD);
        }

        k_msleep(SLEEP_TIME_MS);
	}
	return 0;
}
```
