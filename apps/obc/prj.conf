## CMakeLists.txt
```
# Copyright (c) 2026 The FINCH CubeSat Project Flight Software Contributors
# SPDX-License-Identifier: Apache-2.0

cmake_minimum_required(VERSION 3.20.0)
find_package(Zephyr REQUIRED HINTS $ENV{ZEPHYR_BASE})
project(obc)

target_sources(app PRIVATE src/main.c)
```

## Kconfig
```
# Copyright (c) 2026 The FINCH CubeSat Project Flight Software Contributors
# SPDX-License-Identifier: Apache-2.0
source "Kconfig.zephyr"

config CAN_MODE_LOOPBACK
	bool "Enable CAN hardware loopback mode"
	default n
	help
	  Sets the CAN controller into loopback mode for debugging.
	  Frames are echoed back without needing physical bus connections.
```

## prj.conf
```kconfig
# SPDX-License-Identifier: Apache-2.0

CONFIG_LOG=y
CONFIG_LOG_DEFAULT_LEVEL=3
CONFIG_COMPILER_WARNINGS_AS_ERRORS=y

CONFIG_FINCH_CSP=y
CONFIG_FINCH_CSP_NODE_ADDRESS=1
CONFIG_FINCH_CSP_HOSTNAME="obc"
CONFIG_POSIX_SYSTEM_INTERFACES=y 

# configure littlefs for spi nor memory
CONFIG_SPI=y
CONFIG_FINCH_OBC_FLASH=y
CONFIG_FINCH_OBC_LITTLEFS=y
CONFIG_MAIN_STACK_SIZE=8192

# Configure UART as logging backend
CONFIG_GPIO=y
CONFIG_SERIAL=y
CONFIG_CONSOLE=y
CONFIG_WATCHDOG=y
CONFIG_UART_CONSOLE=y
CONFIG_IWDG_STM32=y
CONFIG_WDT_DISABLE_AT_BOOT=y

# Configure min/max watchdog window size
CONFIG_WDT_MAX_WINDOW=1000
CONFIG_WDT_MIN_WINDOW=0
CONFIG_WDT_OPT=0

# Configure watchdog check interval
CONFIG_WDT_CHECK_INTERVAL=100

# ADCS UART
CONFIG_UART_INTERRUPT_DRIVEN=y
CONFIG_UART_ASYNC_API=y
CONFIG_UART_USE_RUNTIME_CONFIGURE=y

CONFIG_FINCH_ADCS=y
```

## src/main.c
```c
/*
 * Copyright (c) 2025 The FINCH CubeSat Project Flight Software Contributors
 *
 * SPDX-License-Identifier: Apache-2.0
 */

#include <finch/adcs/adcs.h>
#include <finch/csp/csp.h>

#include <finch/obc_flash/util.h>
#include <lfs.h>
#include <lfs_util.h>
#include <finch/obc_littlefs/lfs_callbacks.h>

#include <zephyr/logging/log.h>
#include <zephyr/types.h>
#include <zephyr/sys/util.h>
#include <zephyr/device.h>
#include <zephyr/drivers/watchdog.h>
#include <zephyr/kernel.h>
#include <zephyr/drivers/gpio.h>

LOG_MODULE_REGISTER(obc);

/* SPI controller */
#define SPI_NODE DT_NODELABEL(spi1)
/* Manual CS GPIO. Controlling CS pin manually. */
#define CS_GPIO_NODE DT_NODELABEL(gpioa)
#define CS_PIN       4


// Filesystem configs
lfs_t lfs;
lfs_file_t file;

struct lfs_config cfg = {
    // block device operations
    .read  = lfs_cb_read,
    .prog  = lfs_cb_prog,
    .erase = lfs_cb_erase,
    .sync  = lfs_cb_sync,

    // block device configuration
    .read_size = 4,
    .prog_size = 4,
    .block_size = 4096,
    .block_count = 2048,
    .block_cycles = 500,
    .cache_size = 256,
    .lookahead_size = 16,
    .compact_thresh = 0,
};
struct lfs_flash_context flash_context;

int main(void)
{
	LOG_INF("Board Started");

	/*
	 *	Get internal watchdog from device tree. watchdog0 holdes the address to iwdg, which defines the device in the device tree
	 */
	const struct device *wdt = DEVICE_DT_GET(DT_ALIAS(watchdog0));
	int wdt_channel_id;

    // configuring SPI and GPIO devices for flash operations
    const struct device *spi = DEVICE_DT_GET(SPI_NODE);
    const struct device *gpio = DEVICE_DT_GET(CS_GPIO_NODE);
    int ret = gpio_pin_configure(gpio, CS_PIN, GPIO_OUTPUT_HIGH);
    // unlock flash memory to allow write/erase operations
    ret = obc_flash_global_unlock(spi, gpio, CS_PIN);
    // configure flash context for littlefs
    flash_context.spi = spi;
    flash_context.gpio = gpio;
    flash_context.cs_pin = CS_PIN;
    cfg.context = &flash_context;
    // mount littlefs filesystem, format if mount fails
    int fs_err = lfs_mount(&lfs, &cfg);
    if (fs_err) {
        LOG_INF("Failed to mount filesystem, formatting and retrying...");
        fs_err = lfs_format(&lfs, &cfg);
        // retry mounting after formatting
        fs_err = lfs_mount(&lfs, &cfg);
        if (fs_err) {
            LOG_ERR("Failed to mount filesystem after formatting");
            return fs_err;
        }
    }

	if (!device_is_ready(wdt)) {
		LOG_ERR("%s: device is not ready", wdt->name);
		return 0;
	}

	struct wdt_timeout_cfg wdt_config = {
		/* Reset SoC when watchdog downcounter reaches 0. */
		.flags = WDT_FLAG_RESET_SOC,

		/* Set min and max time window for feeding the timer */
		.window.min = CONFIG_WDT_MIN_WINDOW,
		.window.max = CONFIG_WDT_MAX_WINDOW,
	};

	wdt_channel_id = wdt_install_timeout(wdt, &wdt_config);

	/* Timeout configuration setup */

	if (wdt_channel_id < 0) {
		LOG_ERR("Internal watchdog install error");
		return 0;
	}

	int err = wdt_setup(wdt, CONFIG_WDT_OPT);

	if (err < 0) {
		LOG_ERR("Internal watchdog setup error");
		return 0;
	}

	int rc;
	adcs_rc_t adcs_rc;

	rc = finch_csp_init();
	if (rc < 0) {
		LOG_ERR("Failed to initialize FINCH CSP (%d)", rc);
		return rc;
	}

	adcs_rc = adcs_init();
	if (adcs_rc != ADCS_RC_OK) {
		LOG_ERR("Failed to initialize ADCS (%d)", adcs_rc);
		return adcs_rc;
	}

	/* Verify ADCS ID. */

	uint8_t adcs_id[ADCS_ID_SIZE];
	adcs_rc = adcs_get_id(adcs_id, ADCS_ID_SIZE);

	LOG_INF("ADCS ID: 0x%x 0x%x 0x%x 0x%x 0x%x 0x%x 0x%x 0x%x 0x%x 0x%x 0x%x 0x%x",
			adcs_id[0], adcs_id[1], adcs_id[2], adcs_id[3], adcs_id[4], adcs_id[5],
			adcs_id[6], adcs_id[7], adcs_id[8], adcs_id[9], adcs_id[10], adcs_id[11]);

	/* Sanity check: Check that ADCS status register is clear on bootup*/
	adcs_stat_t adcs_stat = {0};
	adcs_rc = adcs_get_stat(&adcs_stat);
	if (adcs_rc != ADCS_RC_OK) {
		LOG_ERR("Failed to get ADCS status");
		return adcs_rc;
	}

	adcs_stat_t adcs_stat_zero = {0};
	if (memcmp(&adcs_stat, &adcs_stat_zero, sizeof(adcs_stat_t)) != 0) {
		LOG_WRN("ADCS status register non-zero on bootup");
	}


	while (1) {

		/*
		 *	Main loop runs here. If it hangs, feeding will not run
		 */

		int ret = wdt_feed(wdt, wdt_channel_id);

		if (ret < 0) {
			LOG_ERR("Failed to feed the watchdog");
			return 0;
		}
		k_msleep(CONFIG_WDT_CHECK_INTERVAL);
	}

	return 0;
}
```

## src/common.c
```c
/*
 * Copyright (c) 2025 The FINCH CubeSat Project Flight Software Contributors
 *
 * SPDX-License-Identifier: Apache-2.0
 */

/**
 * @file common.c
 * @brief Source for Definitions Common Across Modules 
 */

#include "common.h"
#include <stdbool.h>
#include <zephyr/logging/log.h>

LOG_MODULE_REGISTER(finch_common);

/**
 * @brief Enter specified ADCS control mode
 */
void cmd_adcs_mode(mode_adcs mode, uint8_t* orbit_info, float current_time, uint8_t* tle)
{
	switch (mode) {
		case MODE_ADCS_SAFE:
			LOG_INF("Setting ADCS to Safe mode");
			// Setting ADCS to Safe mode
			break;

		case MODE_ADCS_DETUMBLING:
			LOG_INF("Setting ADCS to Detumbling mode");
			// Set ADCS to Detumbling mode
			break;

		case MODE_ADCS_SUN_POINTING:
			LOG_INF("Setting ADCS to Sun Pointing mode");
			// Set ADCS to Sun Pointing mode
			break;

		case MODE_ADCS_FINE_POINTING:
			LOG_INF("Setting ADCS to Fine Pointing mode");
			// Set ADCS to Fine Pointing mode
			break;

		case MODE_ADCS_LVLH:
			LOG_INF("Setting ADCS to LVLH mode");
			// Set ADCS to LVLH mode
			break;

		case MODE_ADCS_TRACKING:
			LOG_INF("Setting ADCS to Tracking mode");
			// Set ADCS to Tracking mode
			break;

		case MODE_ADCS_OFF:
			LOG_INF("Setting ADCS to Off mode");
			// Set ADCS to Off mode
			break;

		default:
			LOG_WRN("Unknown ADCS control mode");
			break;
	}
}

/**
 * @brief Enter specified PAY control mode
 */
void cmd_pay_mode(mode_pay mode)
{
	switch (mode) {
		case MODE_PAY_OFF:
			LOG_INF("Setting PAY to Off mode");
			// Set PAY to Off mode
			break;

		case MODE_PAY_ON:
			LOG_INF("Setting PAY to On mode");
			// Set PAY to On mode
			break;

		default:
			LOG_WRN("Unknown PAY control mode");
			break;
	}
}
```

## src/common.h
```c
/*
 * Copyright (c) 2025 The FINCH CubeSat Project Flight Software Contributors
 *
 * SPDX-License-Identifier: Apache-2.0
 */

/**
 * @file common.h
 * @brief Header for Definitions Common Across Modules 
 */

#ifndef FINCH_COMMON_H
#define FINCH_COMMON_H

/**
 * @brief System modules
 */
typedef enum system_module {
	MODULE_OPERATOR,
	MODULE_MCC_GS,
	MODULE_RF,
	MODULE_OBC,
	MODULE_ADCS,
	MODULE_PAY
} system_module;

/**
 * @brief Modes of operation
 */
typedef enum mode_op {
	MODE_OP_IDLE,
	MODE_OP_IMAGING,
	MODE_OP_DOWNLINKING,
	MODE_OP_SAFETY,
	MODE_OP_FIRMWARE_UPDATE
} mode_op;

/**
 * @brief ADCS control modes
 */
typedef enum mode_adcs {
	MODE_ADCS_SAFE,
	MODE_ADCS_DETUMBLING,
	MODE_ADCS_SUN_POINTING,
	MODE_ADCS_FINE_POINTING,
	MODE_ADCS_LVLH,
	MODE_ADCS_TRACKING,
	MODE_ADCS_OFF
} mode_adcs;

/**
 * @brief PAY control mode
 */
typedef enum mode_pay {
	MODE_PAY_OFF,
	MODE_PAY_ON
} mode_pay;

/**
 * @brief Enter specified mode of operation
 */
// void enter_mode_op(mode_op mode);

/**
 * @brief Enter specified ADCS control mode
 */
void cmd_adcs_mode(mode_adcs mode, uint8_t* orbit_info, float current_time, uint8_t* tle);

/**
 * @brief Enter specified PAY control mode
 */
void cmd_pay_mode(mode_pay mode);

#endif
```

## src/downlinking.c
```c
/*
 * Copyright (c) 2025 The FINCH CubeSat Project Flight Software Contributors
 *
 * SPDX-License-Identifier: Apache-2.0
 */

/**
 * @file downlinking.c
 * @brief Downlinking Command Sequence Implementation
 */

#include "common.h"
#include "downlinking.h"
#include <stdbool.h>
#include <zephyr/logging/log.h>

LOG_MODULE_REGISTER(downlinking);

/**
 * @brief Main loop for Downlinking command sequence
 */
mode_op downlinking_command_sequence(void)
{
	cmd_adcs_mode(MODE_ADCS_FINE_POINTING, 0, 0.0, 0); // Placeholder values for orbit_info, current_time and tle

	downlink_type dl_type = downlinking_prepare_rf();
	uint8_t* downlink_data;

	if (dl_type == DOWNLINK_TELEMETRY)
	{
		downlink_data = downlinking_get_telemetry_data();
	}

	else if (dl_type == DOWNLINK_IMAGE)
	{
		downlink_data = downlinking_get_image_data();
	}

	int ret = downlinking_downlink_rf(downlink_data);

	// Error handling - to be implemented
	if (ret < 0)
	{
		return ret;
	}

	return MODE_OP_IDLE;
}

/**
 * @brief Prepare RF for downlinking
 */
downlink_type downlinking_prepare_rf(void)
{
	// Implement RF downlink preparation
	// Return type of downlinking
	return NULL;
}

/**
 * @brief Get telemetry data for downlinking
 */
uint8_t* downlinking_get_telemetry_data(void)
{
	// Get telemetry data
	return NULL;
}

/**
 * @brief Get image data for downlinking
 */
uint8_t* downlinking_get_image_data(void)
{
	// Get image data
	return NULL;
}

/**
 * @brief Downlink data to RF
 */
int downlinking_downlink_rf(const uint8_t* downlink_data)
{
	// Implement downlinking data to RF
	return 0;
}
```

## src/downlinking.h
```c
/*
 * Copyright (c) 2025 The FINCH CubeSat Project Flight Software Contributors
 *
 * SPDX-License-Identifier: Apache-2.0
 */

/**
 * @file downlinking.h
 * @brief Header for Downlinking Command Sequence Implementation
 */

#ifndef DOWNLINKING_H
#define DOWNLINKING_H

#include "common.h"

/**
 * @brief Downlink types
 */
typedef enum downlink_type {
  DOWNLINK_TELEMETRY,
	DOWNLINK_IMAGE
} downlink_type;

/**
 * @brief Main loop for Downlinking command sequence
 */
mode_op downlinking_command_sequence(void);

/**
 * @brief Prepare RF for downlinking
 */
downlink_type downlinking_prepare_rf(void);

/**
 * @brief Get telemetry data for downlinking
 */
uint8_t* downlinking_get_telemetry_data(void);

/**
 * @brief Get image data for downlinking
 */
uint8_t* downlinking_get_image_data(void);

/**
 * @brief Downlink data to RF
 */
int downlinking_downlink_rf(const uint8_t* downlink_data);

#endif
```

## src/firmware-update.c
```c
/*
 * Copyright (c) 2025 The FINCH CubeSat Project Flight Software Contributors
 *
 * SPDX-License-Identifier: Apache-2.0
 */

/**
 * @file firmware-update.c
 * @brief Firmware Update Command Sequence Implementation
 */

#include "common.h"
#include "firmware-update.h"
#include <stdbool.h>
#include <zephyr/logging/log.h>

LOG_MODULE_REGISTER(firmware_update);

/**
 * @brief Main loop for Firmware Update command sequence
 */
mode_op firmware_update_command_sequence(void)
{
	// RUN BELOW IN PARALLEL

	// Parallel block 1
	cmd_adcs_mode(MODE_ADCS_FINE_POINTING, 0, 0.0, 0); // Placeholder values for orbit_info, current_time and tle

	// Parallel block 2
	if (cmd_obc_available_update())
	{
		cmd_obc_update();
		// Transmit update feedback to RF
	}

	if (cmd_pay_available_update())
	{
		cmd_pay_update();
		// Transmit update feedback to RF
	}

	// END PARALLEL

	return MODE_OP_IDLE;
}

/**
 * @brief Polls for available OBC firmware upate
 */
int cmd_obc_available_update(void)
{
	// Implement check for OBC firmware update
	return 0;
}

/**
 * @brief Polls for available PAY firmware upate
 */
int cmd_pay_available_update(void)
{
	// Implement check for PAY firmware update
	return 0;
}

/**
 * @brief Executes OBC firmware update
 */
int cmd_obc_update(void)
{
	// Implement OBC firmware update
	return 0;
}

/**
 * @brief Executes PAY firmware update
 */
int cmd_pay_update(void)
{
	// Implement PAY firmware update
	return 0;
}
```

## src/firmware-update.h
```c
/*
 * Copyright (c) 2025 The FINCH CubeSat Project Flight Software Contributors
 *
 * SPDX-License-Identifier: Apache-2.0
 */

/**
 * @file firmware-update.h
 * @brief Header for Firmware Update Command Sequence Implementation
 */

#ifndef FIRMWARE_UPDATE_H
#define FIRMWARE_UPDATE_H

#include "common.h"

/**
 * @brief Main loop for Firmware Update command sequence
 */
mode_op firmware_update_command_sequence(void);

/**
 * @brief Polls for available OBC firmware upate
 */
int obc_available_update(void);

/**
 * @brief Polls for available PAY firmware upate
 */
int pay_available_update(void);

/**
 * @brief Executes OBC firmware update
 */
int obc_update(void);

/**
 * @brief Executes PAY firmware update
 */
int pay_update(void);

#endif
```

## src/idle.c
```c
/*
 * Copyright (c) 2025 The FINCH CubeSat Project Flight Software Contributors
 *
 * SPDX-License-Identifier: Apache-2.0
 */

/**
 * @file
 * @brief Idle command sequence implementation
 */

#include "idle.h"
#include <stdbool.h>
#include <zephyr/logging/log.h>

LOG_MODULE_REGISTER(idle, LOG_LEVEL_INF);

/**
 * @brief OBC transmits spacecraft orient command
 */
int obc_command_orient(const char *attitude)
{
	// sim transmission
	return 0;
}

/**
 * @brief Orient satellite through ADCS
 */
static bool adcs_execute_orient(const char *attitude)
{
	// sim execution
	return true;
}

/**
 * @brief Performs internal system health check on OBC
 */
static bool obc_system_health_check(void)
{
	//add internal logic
	return true;
}

/**
 * @brief OBC checks for scheduled tasks
 */
static bool obc_check_scheduled(void)
{
	// sim check
	return true;
}

/**
 * @brief OBC Schedules mode change
 */
int obc_scheduled_mode_change(const char *command_mode, const char *mode_params, const char *schedule)
{
	// sim succcessful scheduling
	return 0;
}

/**
 * @brief OBC logs error
 */
void obc_log_error(const char *errortype)
{
	LOG_INF("OBC error: %s", errortype);
}

/**
 * @brief if contact is not established between RF and OBC
 */
void rf_msg_error(const char *errortype)
{
	LOG_INF("RF message error: %s", errortype);
}

/**
 * @brief PAY enters specified mode
 */
int pay_enter_mode(const char *command_mode)
{
	// sim mode entry
	return 0;
}

/**
 * @brief RF transmits command to OBC
 */
static bool rf_transmit_command_modechange(const char *command_mode, const char *mode_params, const char *schedule)
{
	// sim transmission
	return true;
}

/**
 * @brief MCC transmits command to RF
 */
int mcc_transmit_command_modechange(const char *command_mode, const char *mode_params, const char *schedule)
{
	// sim transmission
	return 0;
}

/**
 * @brief Main loop handling the idle command sequence logic
 */
int idle_command_sequence(void)
{
	const char *attitude = "sunpointing";
	const char *command_mode = "cmdmode";
	const char *mode_params = "modeparams";
	const char *schedule = "scheduled";
	const char *errortype = "comms";

	// unused for now
	(void)attitude;
	(void)command_mode;
	(void)mode_params;
	(void)schedule;
	(void)errortype;

	obc_command_orient("sunpointing");
	if (adcs_execute_orient("sunpointing") == true) {
		if (obc_system_health_check() == false) {
			pay_enter_mode("safety");
		}
	} else {
		pay_enter_mode("safety");
	}

	if (obc_check_scheduled() == true) {
		// sim scheduled
		pay_enter_mode("cmdmode");
	}

	mcc_transmit_command_modechange("cmdmode", "modeparams", "scheduled");

	if (rf_transmit_command_modechange("cmdmode", "modeparams", "scheduled") == true) {
		if (obc_scheduled_mode_change("cmdmode", "modeparams", "scheduled") == true) {
			pay_enter_mode("cmdmode");
		} else {
			obc_log_error("comms");
		}
	} else {
		rf_msg_error("comms");
		obc_log_error("comms");
		pay_enter_mode("safety");
	}
	return 0;
}

// to avoid unused function warning cppcheck
(void)idle_command_sequence;
```

## src/idle.h
```c
/*
 * Copyright (c) 2025 The FINCH CubeSat Project Flight Software Contributors
 *
 * SPDX-License-Identifier: Apache-2.0
 */

/**
 * @file idle.h
 * @brief Header for Idle Command Sequence Logic
 */

#ifndef idle_h
#define idle_h

#include <stdbool.h>

/**
 * @brief system modules involved in idle command sequence
 */
typedef enum system_module {
	MODULE_OPERATOR,
	MODULE_MCC_GS,
	MODULE_RF,
	MODULE_OBC,
	MODULE_ADCS,
	MODULE_PAY
} system_module;

/**
 * @brief executes the idle command sequence
 */
int idle_command_sequence(void);

#endif
```

## src/imaging.c
```c
/*
 * Copyright (c) 2025 The FINCH CubeSat Project Flight Software Contributors
 *
 * SPDX-License-Identifier: Apache-2.0
 */

/**
 * @file imaging.c
 * @brief Imaging Command Sequence Implementation
 */

#include "common.h"
#include "imaging.h"
#include <stdbool.h>
#include <zephyr/logging/log.h>

LOG_MODULE_REGISTER(imaging);

/**
 * @brief Main loop for Imaging command sequence
 */
mode_op imaging_command_sequence(void)
{
	cmd_pay_camera_cool();

	cmd_adcs_mode(MODE_ADCS_FINE_POINTING, 0, 0.0, 0); // Placeholder values for orbit_info, current_time and tle

	cmd_pay_camera_image();
	LOG_INF("Image capture complete");

	// If near ground station
	if (true) // Placeholder condition
	{
		return MODE_OP_DOWNLINKING;
	}

	else
	{
		LOG_INF("Downlink request"); // Log downlink request

		return MODE_OP_IDLE;
	}
}

/**
 * @brief Execute camera cooling
 */
int cmd_pay_camera_cool(void)
{
	// Implement camera cooling
	return 0;
}

/**
 * @brief Execute image capture
 */
int cmd_pay_camera_image(void)
{
	// Implement image capture
	return 0;
}
```

## src/imaging.h
```c
/*
 * Copyright (c) 2025 The FINCH CubeSat Project Flight Software Contributors
 *
 * SPDX-License-Identifier: Apache-2.0
 */

/**
 * @file imaging.h
 * @brief Header for Imaging Command Sequence Implementation
 */

#ifndef IMAGING_H
#define IMAGING_H

#include "common.h"

/**
 * @brief Main loop for Imaging command sequence
 */
mode_op imaging_command_sequence(void);

/**
 * @brief Execute camera cooling
 */
int cmd_pay_camera_cool(void);

/**
 * @brief Execute image capture
 */
int cmd_pay_camera_image(void);

#endif
```

## src/init.c
```c
/*
 * Copyright (c) 2025 The FINCH CubeSat Project Flight Software Contributors
 *
 * SPDX-License-Identifier: Apache-2.0
 */

/**
 * @file init.c
 * @brief Init Command Sequence Implementation
 */

#include "common.h"
#include "imaging.h"
#include <stdbool.h>
#include <zephyr/logging/log.h>

LOG_MODULE_REGISTER(initializing_sequence);

int init() {
    mode_op operation = MODE_OP_IDLE;

    while (1) {
        switch (operation) {
            case MODE_OP_IDLE:
                LOG_INF("Entering Idle mode");

                operation = idle_command_sequence();
                
                break;

            case MODE_OP_IMAGING:
                LOG_INF("Entering Imaging mode");

                operation = imaging_command_sequence();

                break;

            case MODE_OP_DOWNLINKING:
                LOG_INF("Entering Downlinking mode");

                operation = downlinking_command_sequence();
                
                break;

            case MODE_OP_SAFETY:
                LOG_INF("Entering Safety mode");

                operation = safety_command_sequence();

                break;

            case MODE_OP_FIRMWARE_UPDATE:
                LOG_INF("Entering Firmware Update mode");

                operation = firmware_update_command_sequence();

                break;

            default:
                LOG_WRN("Unknown mode of operation");

                operation = MODE_OP_SAFETY;

                break;
        }
    }
}
```

## src/obc_check.c
```c
/*
 * Copyright (c) 2025 The FINCH CubeSat Project Flight Software Contributors
 *
 * SPDX-License-Identifier: Apache-2.0
 */

#include "obc_check.h"
#include <stdbool.h>
#include <stdio.h>

/*
 * static functions keep internal logic here
 */

// individual node pings (Level 3)
static bool ping_srs4(void)
{
	printf("Pinging SRS4...\n");
	// TODO: implement actual logic
	return true; // simulated success
}

static bool ping_eps(void)
{
	printf("Pining EPS (Power)...\n");
	// TODO: actual logic
	return true; // simulated success
}

static bool ping_10m(void)
{
	printf("Pinging ADCS...\n");
	// TODO: actual logic
	return true; // simulated success
}

// Level 2
static bool ping_all_CSP_nodes(void)
{
	bool srs4_ok = ping_srs4();
	bool EPS_ok = ping_eps();
	bool ADCS_ok = ping_10m();

	return srs4_ok && EPS_ok && ADCS_ok;
}

static bool flash_check(void)
{
	printf("checking flash memory...\n");
	// TODO: logic
	return true; // simnulated success
}

static bool external_RTC_check(void)
{
	printf("Checking external RTC...\n");
	// TODO: logic
	return true; // sim success
}

// level 1
bool obc_check(void)
{
	bool ping_ok = ping_all_CSP_nodes;
	bool flash_ok = flash_check;
	bool RTC_ok = external_RTC_check;

	return ping_ok && flash_ok && RTC_ok;
}

// to avoid unused function warning cppcheck
(void)obc_check;
```
