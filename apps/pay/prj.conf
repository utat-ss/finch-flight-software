## CMakeLists.txt
```
# Copyright (c) 2026 The FINCH CubeSat Project Flight Software Contributors
# SPDX-License-Identifier: Apache-2.0

cmake_minimum_required(VERSION 3.20.0)
find_package(Zephyr REQUIRED HINTS $ENV{ZEPHYR_BASE})
project(pay)

target_sources(app PRIVATE src/main.c)
```

## prj.conf
```kconfig
# SPDX-License-Identifier: Apache-2.0

CONFIG_LOG=y
CONFIG_LOG_DEFAULT_LEVEL=3
CONFIG_COMPILER_WARNINGS_AS_ERRORS=y
CONFIG_FINCH_CSP=y
CONFIG_FINCH_CSP_NODE_ADDRESS=2
CONFIG_FINCH_CSP_HOSTNAME="pay"

# CSP over CAN (libcsp Zephyr CAN driver requires the heap and k_event API)
CONFIG_CAN=y
CONFIG_FINCH_CSP_HAVE_CAN=y
CONFIG_EVENTS=y
CONFIG_HEAP_MEM_POOL_SIZE=2048

# Configure UART as logging backend
CONFIG_GPIO=y
CONFIG_SERIAL=y
CONFIG_CONSOLE=y
CONFIG_UART_CONSOLE=y
```

## src/main.c
```c
/*
 * Copyright (c) 2025 The FINCH CubeSat Project Flight Software Contributors
 *
 * SPDX-License-Identifier: Apache-2.0
 */

#include <finch/csp/csp.h>
#include <zephyr/kernel.h>
#include <zephyr/logging/log.h>

LOG_MODULE_REGISTER(pay);

int main(void)
{
	int ret = finch_csp_init();

	if (ret < 0) {
		/* TODO FDIR must handle this situation! */
		LOG_ERR("Failed to initialize FINCH CSP (%d)", ret);
		return ret;
	}

	while (1) {
		LOG_INF("pay");
		k_msleep(1000);
	}
	return 0;
}
```
