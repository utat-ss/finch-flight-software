## Kconfig
```kconfig
# Copyright (c) 2025 The FINCH CubeSat Project Flight Software Contributors
# SPDX-License-Identifier: Apache-2.0

menu "FINCH Firmware"

config FINCH_DEVELOPMENT
	bool "Enable development build features"
	help
	  Enables non-flight development features.

if FINCH_DEVELOPMENT

config LOG
	default y

config LOG_DEFAULT_LEVEL
	default 3

config CONSOLE
	default y

config UART_CONSOLE
	default y

endif

rsource "lib/Kconfig"

endmenu
```

## boards/obc/Kconfig.obc
```kconfig
# Copyright (c) 2025 The FINCH CubeSat Project Flight Software Contributors
# SPDX-License-Identifier: Apache-2.0

config BOARD_OBC
        select SOC_STM32G431XX

config WDT_MAX_WINDOW
        int "Maximum watchdog window"
        default 1000

config WDT_MIN_WINDOW
        int "Minimum watchdog window"
        default 0

config WDT_OPT
        int "Watchdog configuration options"
        default 0

config WDT_CHECK_INTERVAL
        int "Watchdog check interval"
        default 100
```

## boards/pay/Kconfig.pay
```kconfig
# Copyright (c) 2026 The FINCH CubeSat Project Flight Software Contributors
# SPDX-License-Identifier: Apache-2.0

config BOARD_PAY
	select SOC_STM32H743XX
```

## lib/Kconfig
```kconfig
# Copyright (c) 2025 The FINCH CubeSat Project Flight Software Contributors
# SPDX-License-Identifier: Apache-2.0

menu "FINCH CubeSat Flight Software Libraries"

rsource "adcs/Kconfig"
rsource "ccsds123b/Kconfig"
rsource "csp/Kconfig"

endmenu
```

## lib/csp/Kconfig
```kconfig
# Copyright (c) 2026 The FINCH CubeSat Project Flight Software Contributors
# SPDX-License-Identifier: Apache-2.0

config FINCH_CSP
	bool "Enable FINCH CSP integration"
	select LIBCSP
	help
	  Build the FINCH libcsp integration layer.

if FINCH_CSP

config FINCH_CSP_NODE_ADDRESS
	int "CSP node address"
	range 0 16382
	default 1
	help
	  CSP address used for this image.
	  16383 is reserved as the CSP broadcast address.

config FINCH_CSP_HOSTNAME
	string "CSP hostname"
	default "finch"
	help
	  Hostname exposed via CSP management services.

config FINCH_CSP_MODEL
	string "CSP model"
	default "finch-flight-software"
	help
	  Model string exposed via CSP management services.

config FINCH_CSP_REVISION
	string "CSP revision"
	default "dev"
	help
	  Revision string exposed via CSP management services.

config FINCH_CSP_ROUTER_STACK_SIZE
	int "CSP router thread stack size"
	default 1024
	help
	  Stack size for the CSP router thread.

config FINCH_CSP_ROUTER_PRIORITY
	int "CSP router thread priority"
	default 1
	help
	  Zephyr thread priority for the CSP router thread.

endif # FINCH_CSP
```

## lib/finch/adcs/Kconfig
```kconfig
# Copyright (c) 2026 The FINCH CubeSat Project Flight Software Contributors
# SPDX-License-Identifier: Apache-2.0

config FINCH_ADCS
	bool "Support for ADCS 10M"
	help
	  This option enables the ADCS communication library.
```

## lib/obc_flash/Kconfig
```kconfig
# Copyright (c) 2025 The FINCH CubeSat Project Flight Software Contributors
# SPDX-License-Identifier: Apache-2.0

config FINCH_OBC_FLASH
    bool "FINCH OBC Flash Library"
```

## lib/obc_littlefs/Kconfig
```kconfig
# Copyright (c) 2025 The FINCH CubeSat Project Flight Software Contributors
# SPDX-License-Identifier: Apache-2.0

config FINCH_OBC_LITTLEFS
    bool "FINCH OBC LittleFS Library"
```

## tests/ccsds123b/benchmark/testcase.yaml
```yaml
tests:
  ccsds123b.benchmark:
    tags: subsystem-integration-tests
    platform_allow: nucleo_h743zi
```

## tests/ccsds123b/debug/testcase.yaml
```yaml
tests:
  ccsds123b.debug:
    tags: subsystem-integration-tests
    platform_allow: nucleo_h743zi
```

## west.yml
```yaml
manifest:
  version: 1.2
  projects:
    - name: zephyr
      url: https://github.com/zephyrproject-rtos/zephyr.git
      revision: 684c9e8f32e4373a21098559f748f06915f950c9 # v4.4.0
      path: zephyr
      import:
        name-allowlist:
          - hal_stm32
          - cmsis_6
      west-commands: scripts/west-commands.yml
    - name: libcsp
      url: https://github.com/libcsp/libcsp.git
      # not a stable revision; run git blame and git show for justification
      revision: 65bc556f7bd658d17833d689b3023e4c03c9165e
      path: modules/lib/libcsp
```
