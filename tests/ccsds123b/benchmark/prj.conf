## CMakeLists.txt
```
cmake_minimum_required(VERSION 3.20.0)
find_package(Zephyr REQUIRED HINTS $ENV{ZEPHYR_BASE})
project(benchmark-ccsds123b)

include_directories(../../../include)

file(GLOB SOURCES src/*.c)

set(CCSDS123B_SOURCES
    ${CMAKE_CURRENT_SOURCE_DIR}/../../../lib/ccsds123b/src/constants.c
    ${CMAKE_CURRENT_SOURCE_DIR}/../../../lib/ccsds123b/src/encoder.c
    ${CMAKE_CURRENT_SOURCE_DIR}/../../../lib/ccsds123b/src/predictor.c
    ${CMAKE_CURRENT_SOURCE_DIR}/../../../lib/ccsds123b/src/util.c
)

target_sources(app PRIVATE ${SOURCES} ${CCSDS123B_SOURCES})
```

## prj.conf
```kconfig
CONFIG_ZTEST=y
CONFIG_LOG=y
CONFIG_LOG_DEFAULT_LEVEL=3
```

## src/main.c
```c
/*
 * Copyright (c) 2026 The FINCH CubeSat Project Flight Software Contributors
 *
 * SPDX-License-Identifier: Apache-2.0
 */

#include <finch/ccsds123b/predictor.h>
#include <finch/ccsds123b/encoder.h>
#include <finch/ccsds123b/image.h>
#include <finch/ccsds123b/util.h>
#include <finch/ccsds123b/constants.h>

#include <stdio.h>
#include <zephyr/logging/log.h>
#include <zephyr/logging/log_ctrl.h>
#include <zephyr/ztest.h>

Predictions prediction;
EncoderOut encoding;

LOG_MODULE_REGISTER(bench);

ZTEST_SUITE(benchmark_test, NULL, NULL, NULL, NULL, NULL);

ZTEST(benchmark_test, test_benchmark)
{
	LOG_INF("Starting the image compression benchmark.");
	LOG_INF("N_Z = %d, N_Y = %d, N_X = %d", N_Z, N_Y, N_X);
	log_flush();

	img_init();
	const vec3 *N = img_get_N();

	LOG_INF("Image initialized");
	LOG_INF("Calling predict_image");
	log_flush();

	predict_image(N, prediction);

	LOG_INF("Finished predict_image");
	LOG_INF("Calling encode_prediction");
	log_flush();

	encode_prediction(N, prediction, encoding);

	LOG_INF("Finished encode_prediction");
	LOG_INF("Image compression benchmark has finished!");
	log_flush();
}
```

## src/arrays.c
```c
/*
 * Copyright (c) 2026 The FINCH CubeSat Project Flight Software Contributors
 *
 * SPDX-License-Identifier: Apache-2.0
 */

#include <finch/ccsds123b/arrays.h>
#include <finch/ccsds123b/constants.h>

void update_local_diffs(LocalDiffs diffs, int z, int y, int x, const LocalDiff *l)
{
	diffs[z % N_TILE_Z][y % N_TILE_Y][x % N_TILE_X] = *l;
}

LocalDiff get_local_diffs(const LocalDiffs diffs, int z, int y, int x)
{
	return diffs[z % N_TILE_Z][y % N_TILE_Y][x % N_TILE_X];
}

void update_predictions(Predictions p, int z, int y, int x, int32_t value)
{
	p[z % N_TILE_Z][y % N_TILE_Y][x % N_TILE_X] = value;
}

int32_t get_predictions(const Predictions p, int z, int y, int x)
{
	return p[z % N_TILE_Z][y % N_TILE_Y][x % N_TILE_X];
}

EncoderOutItem get_encoder_out(EncoderOut out, int z, int y, int x)
{
	return out[z % N_TILE_Z][y % N_TILE_Y][x % N_TILE_X];
}
```

## src/image.c
```c
/*
 * Copyright (c) 2026 The FINCH CubeSat Project Flight Software Contributors
 *
 * SPDX-License-Identifier: Apache-2.0
 */

#include <finch/ccsds123b/image.h>
#include <finch/ccsds123b/constants.h>

#include <finch/ccsds123b/util.h>

vec3 N_tile = (vec3){ N_TILE_Z, N_TILE_Y, N_TILE_X };
int img[N_TILE_Z][N_TILE_Y][N_TILE_X];

vec3 N = (vec3) { N_Z, N_Y, N_X };

void img_init(void)
{
	int c = 0;

	for (int z = 0; z < N_tile.z; ++z) {
		for (int y = 0; y < N_tile.y; ++y) {
			for (int x = 0; x < N_tile.x; ++x) {
				img[z][y][x] = c++;
			}
		}
	}
}

const vec3 *img_get_N(void)
{
	return &N;
}

int img_get_pxl(int z, int y, int x)
{
	return img[z % N_tile.z][y % N_tile.y][x % N_tile.x];
}

int img_get_pxl_t(int z, int t)
{
	int y = t / N.x;
	int x = t % N.x;

	return img_get_pxl(z, y, x);
}
```
