## CMakeLists.txt
```
# Copyright (c) 2025 The FINCH CubeSat Project Flight Software Contributors
# SPDX-License-Identifier: Apache-2.0

cmake_minimum_required(VERSION 3.20.0)
find_package(Zephyr REQUIRED HINTS $ENV{ZEPHYR_BASE})
project(heater_driver)

target_sources(app PRIVATE
  src/main.c
  src/heater-driver.c
)

target_include_directories(app PRIVATE
  ${CMAKE_CURRENT_SOURCE_DIR}/../include
)
```

## prj.conf
```kconfig
# SPDX-License-Identifier: Apache-2.0

CONFIG_LOG=y
CONFIG_LOG_DEFAULT_LEVEL=3
CONFIG_ADC=y
CONFIG_GPIO=y
CONFIG_ADC_STM32=y
CONFIG_GPIO_STM32=y
```

## src/main.c
```c
/*
 * Copyright (c) 2025 The FINCH CubeSat Project Flight Software Contributors
 *
 * SPDX-License-Identifier: Apache-2.0
 */

#include <zephyr/kernel.h>
#include <zephyr/device.h>
#include <zephyr/drivers/gpio.h>
#include <zephyr/sys/printk.h>
#include <zephyr/devicetree.h>

#define TEMP_THRESHOLD 2000  // Adjust based on testing (e.g. 12-bit ADC ~ 0-4095)

void main(void)
{
    const struct device *adc_dev = DEVICE_DT_GET(DT_NODELABEL(adc1));
    const struct device *gpio_dev = DEVICE_DT_GET(DT_NODELABEL(gpioa));

    printk("Starting heater controller...\n");

    while (1) {
        int temp = read_temperature(adc_dev);

        if (temp < 0) {
            printk("ADC read failed\n");
        } else {
        	printk("Temperature (ADC): %d\n", temp);

        	if (temp < TEMP_THRESHOLD) {
                printk("Temperature low, turning heater ON\n");
                control_heater(gpio_dev, 1);
            } else {
                printk("Temperature sufficient, turning heater OFF\n");
                control_heater(gpio_dev, 0);
            }
        }

        k_msleep(1000);  // Sample once per second
    }
}
```

## src/heater-driver.c
```c
/*
 * Copyright (c) 2025 The FINCH CubeSat Project Flight Software Contributors
 *
 * SPDX-License-Identifier: Apache-2.0
 */

#include <heater-driver.h>
#include <zephyr/kernel.h>
#include <zephyr/device.h>
#include <zephyr/drivers/adc.h>
#include <zephyr/drivers/gpio.h>

#define ADC_CHANNEL     0
#define ADC_INPUT       0
#define ADC_RESOLUTION  12
#define HEATER_PIN      1   // PA1

int read_temperature(const struct device *adc_dev)
{
    if (!device_is_ready(adc_dev)) {
        return -1;
    }

    int16_t sample_buffer;
    struct adc_channel_cfg channel_cfg = {
        .gain             = ADC_GAIN_1,
        .reference        = ADC_REF_INTERNAL,
        .acquisition_time = ADC_ACQ_TIME_DEFAULT,
        .channel_id       = ADC_CHANNEL,
        .differential     = 0,
        .input_positive   = ADC_INPUT,
    };

    struct adc_sequence sequence = {
        .channels    = BIT(ADC_CHANNEL),
        .buffer      = &sample_buffer,
        .buffer_size = sizeof(sample_buffer),
        .resolution  = ADC_RESOLUTION,
    };

    if (adc_channel_setup(adc_dev, &channel_cfg) < 0) {
        return -1;
    }

    if (adc_read(adc_dev, &sequence) < 0) {
        return -1;
    }

    return sample_buffer;
}

void control_heater(const struct device *gpio_dev, bool state)
{
    if (!device_is_ready(gpio_dev)) {
        return;
    }

    gpio_pin_configure(gpio_dev, HEATER_PIN, GPIO_OUTPUT_ACTIVE);
    gpio_pin_set(gpio_dev, HEATER_PIN, state);
}
```
