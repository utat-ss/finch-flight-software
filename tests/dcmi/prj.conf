## CMakeLists.txt
```
# Copyright (c) 2025 The FINCH CubeSat Project Flight Software Contributors
# SPDX-License-Identifier: Apache-2.0

cmake_minimum_required(VERSION 3.20.0)
find_package(Zephyr REQUIRED HINTS $ENV{ZEPHYR_BASE})
project(pay)

zephyr_include_directories(${CMAKE_CURRENT_SOURCE_DIR}/../../include)

target_sources(app PRIVATE 
    src/main.c
    ../../lib/dcmi/dcmi_ov7670.c
)
```

## prj.conf
```kconfig
# SPDX-License-Identifier: Apache-2.0

CONFIG_LOG=y
CONFIG_LOG_DEFAULT_LEVEL=3
CONFIG_COMPILER_WARNINGS_AS_ERRORS=y
CONFIG_PINCTRL=y
CONFIG_I2C=y
CONFIG_I2C_STM32=y
CONFIG_DMA=y
CONFIG_DMA_STM32=y
CONFIG_VIDEO=y
CONFIG_VIDEO_STM32_DCMI=y
CONFIG_VIDEO_OV7670=y
CONFIG_VIDEO_BUFFER_POOL_SZ_MAX=76800
CONFIG_VIDEO_BUFFER_POOL_NUM_MAX=2   
```

## src/main.c
```c
/*
 * Copyright (c) 2025 The FINCH CubeSat Project Flight Software Contributors
 *
 * SPDX-License-Identifier: Apache-2.0
 */

#include <zephyr/kernel.h>
#include <zephyr/drivers/video.h>
#include <zephyr/device.h>
#include <zephyr/sys/util.h>
#include <zephyr/logging/log.h>
#include <zephyr/drivers/dma/dma_stm32.h>
#include "dcmi/dcmi_ov7670.h"

struct video_format fmt = {
    .pixelformat = VIDEO_PIX_FMT_RGB565,
    .width = 320,
    .height = 240,
};

const struct device* ov7670 = DEVICE_DT_GET(DT_NODELABEL(ov7670));

LOG_MODULE_REGISTER(pay);

int main(void)
{
    if (camera_init(ov7670, &fmt)) {
        LOG_ERR("Failed to start camera");
        return 1;
    }
    camera_loop(ov7670);

	return 0;
}
```
